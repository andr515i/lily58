## config/west.yml
```yaml
manifest:
  remotes:
    - name: zmkfirmware
      url-base: https://github.com/zmkfirmware
  projects:
    - name: zmk
      remote: zmkfirmware
      # revision: ac7f75b
      revision: v0.3
      import: app/west.yml
  self:
    path: config
```
